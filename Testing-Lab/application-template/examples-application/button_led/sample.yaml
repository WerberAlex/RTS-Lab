## Testing-Lab/application-template/examples-application/button_led/sample.yaml
```yaml
sample:
  name: Button LED
tests:
  sample.button_led.robot:
    tags: gpio
    platform_allow: stm32f7
    integration_platforms:
      - stm32f7
    harness: robot
    harness_config:
      robot_test_path: button_led.robot
```

## Testing-Lab/application-template/examples-application/button_led/tests/unit/testcase.yaml
```yaml
tests:
  unit.button_led:
    tags: gpio
    platform_allow: stm32f7
    integration_platforms:
      - stm32f7
    harness: ztest
```

## Testing-Lab/application-template/examples-application/ztest_module/testcase.yaml
```yaml
tests:
  shell.ztest.dynamic_cmd:
    tags:
      - shell
      - ztest
    harness: ztest
    platform_allow: stm32f7
    integration_platforms:
      - stm32f7
```
